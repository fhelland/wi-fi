## sdkconfig.defaults
```kconfig
CONFIG_HTTPD_MAX_REQ_HDR_LEN=1024
CONFIG_FATFS_LFN_HEAP=y
CONFIG_FATFS_MAX_LFN=255

CONFIG_ESP32_WIFI_STATIC_RX_BUFFER_NUM=6
CONFIG_ESP32_WIFI_DYNAMIC_RX_BUFFER_NUM=16
CONFIG_ESP32_WIFI_DYNAMIC_TX_BUFFER_NUM=20
CONFIG_ESP32_WIFI_RX_BA_WIN=10
CONFIG_ESP32_WIFI_IRAM_OPT=y
CONFIG_ESP32_WIFI_RX_IRAM_OPT=y
CONFIG_LWIP_IRAM_OPTIMIZATION=y
CONFIG_LWIP_TCP_SND_BUF_DEFAULT=20480
CONFIG_LWIP_TCP_WND_DEFAULT=20480
CONFIG_LWIP_TCP_RECVMBOX_SIZE=14
CONFIG_LWIP_MAX_SOCKETS=13

# The following settings are used to make sure boot time is as short as possible:
# Set flash configuration as fast as possible (Quad I/O 80MHz)
# (Not all hardware may support this configuration.)
# CONFIG_ESPTOOLPY_FLASHMODE_QIO=y
 CONFIG_ESPTOOLPY_FLASHFREQ_80M=y

# These two settings mean that no logs are printed
# during startup, but it's possible to use esp_log_level_set("*", ESP_LOG_INFO)
# at runtime to get Info-level logging back
CONFIG_LOG_DEFAULT_LEVEL_WARN=y
CONFIG_LOG_MAXIMUM_LEVEL_INFO=y
CONFIG_BOOTLOADER_LOG_LEVEL_WARN=y

# at risk of not detecting flash corruption, skip bootloader
# verification of the app unless a soft reset or crash happened
#
# note: the larger the application, the bigger the time saved by
# from this option
CONFIG_BOOTLOADER_SKIP_VALIDATE_ON_POWER_ON=y
CONFIG_BOOTLOADER_SKIP_VALIDATE_IN_DEEP_SLEEP=y

# Not calibrating RTC_SLOW_CLK saves a small amount of time during boot.
#
# Setting option to zero is only recommended if not using sleep modes, or
# if you don't need accurate sleep times.
# CONFIG_ESP32_RTC_CLK_CAL_CYCLES=0
```
